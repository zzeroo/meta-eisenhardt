## conf/distro/eisenhardt.conf
```bitbake
DISTRO_NAME = "Eisenhardt"
DISTRO_VERSION = "0.1.1"


DISTRO_FEATURES ?= "${DISTRO_FEATURES_DEFAULT} ${DISTRO_FEATURES_LIBC} \
                    ${OWN_DISTRO_FEATURES}"
OWN_DISTRO_FEATURES = "wayland opengl"

# systemd default init manager
DISTRO_FEATURES_append = " systemd"
VIRTUAL-RUNTIME_init_manager = "systemd"
DISTRO_FEATURES_BACKFILL_CONSIDERED = "sysvinit"
VIRTUAL-RUNTIME_initscripts = ""
```

## conf/layer.conf
```bitbake
# We have a conf and classes directory, add to BBPATH
BBPATH .= ":${LAYERDIR}"

# We have recipes-* directories, add to BBFILES
BBFILES += "${LAYERDIR}/recipes-*/*/*.bb \
            ${LAYERDIR}/recipes-*/*/*.bbappend"

BBFILE_COLLECTIONS += "meta-eisenhardt"
BBFILE_PATTERN_meta-eisenhardt = "^${LAYERDIR}/"
BBFILE_PRIORITY_meta-eisenhardt = "6"

LAYERDEPENDS_meta-eisenhardt = "core"
LAYERSERIES_COMPAT_meta-eisenhardt = "dunfell"
```
